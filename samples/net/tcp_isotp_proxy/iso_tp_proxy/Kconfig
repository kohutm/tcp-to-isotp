## samples/net/tcp_isotp_proxy/iso_tp_proxy/Kconfig
```kconfig
# Copyright (c) 2025 N-Ix
# SPDX-License-Identifier: Apache-2.0

menu "ISO-TP Proxy Configuration"

config CAN_ISOTP_PROXY
	bool "Enable ISO-TP proxy support"
	depends on TCP_LINK && ISOTP
	default n
	help
	  Enable ISO-TP proxy functionality to forward CAN messages over TCP.
	  This is useful for applications that need to bridge CAN and TCP networks.
	  It allows the TCP server to handle ISO-TP messages and forward them to the
	  CAN bus.
	  This is particularly useful in automotive and industrial applications
	  where CAN networks are prevalent.

config CAN_ISOTP_PROXY_RX_THREAD_NAME
	string "ISO-TP RX thread name"
	depends on CAN_ISOTP_PROXY
	default "isotp_rx_thread"
	help
	  Name of the thread that handles receiving ISO-TP messages over CAN.

config CAN_ISOTP_PROXY_TX_ID
	hex "ISO-TP TX CAN ID"
	depends on CAN_ISOTP_PROXY
	default 0x180
	help
	  Default CAN ID used for transmitting ISO-TP messages.

config CAN_ISOTP_PROXY_RX_ID
	hex "ISO-TP RX CAN ID"
	depends on CAN_ISOTP_PROXY
	default 0x80
	help
	  Default CAN ID used for receiving ISO-TP messages.

config CAN_ISOTP_PROXY_TCP_LINK_TX_SRC_ID
	int "TCP Link TX source ID"
	depends on CAN_ISOTP_PROXY
	default 16435
	help
	  Source ID for TCP Link messages sent over ISO-TP.
	  This is used to identify the sender of the messages.

config CAN_ISOTP_PROXY_TCP_LINK_TX_DST_ID
	int "TCP Link TX destination ID"
	depends on CAN_ISOTP_PROXY
	default 16435
	help
	  Destination ID for TCP Link messages sent over ISO-TP.
	  This is used to identify the intended recipient of the messages.

config CAN_ISOTP_PROXY_TX_QUEUE_NAME
	string "CAN ISOTP TX queue name"
	default "can_isotp_tx_queue"
	depends on CAN_ISOTP_PROXY
	help
	  Queue name for CAN ISOTP transmission.

config CAN_ISOTP_PROXY_MAX_PAYLOAD_SIZE
	int "ISO-TP maximum payload size"
	depends on CAN_ISOTP_PROXY
	default 256
	help
	  Maximum payload size for ISO-TP messages in bytes.
	  This should match the expected payload size of the messages being transmitted.

config CAN_ISOTP_PROXY_FC_BC
	int "Block Size for Flow Control"
	depends on CAN_ISOTP_PROXY
	default 8
	help
	  Block size for flow control in ISO-TP messages.
	  This defines how many consecutive frames can be sent before
	  waiting for a flow control frame.

config CAN_ISOTP_PROXY_FC_STMIN
	int "Separation Time for Flow Control"
	depends on CAN_ISOTP_PROXY
	default 0
	help
	  Separation time in milliseconds for flow control frames.
	  This is the time to wait before sending the next frame after a flow control frame.

config CAN_ISOTP_PROXY_CAN_FD
	bool "Enable CAN FD support"
	depends on CAN_ISOTP_PROXY
	default n
	help
	  Enable CAN FD (Flexible Data-rate) support for the ISO-TP proxy.
	  This allows for larger payloads and faster data rates when using
	  CAN FD capable hardware.

config CAN_ISOTP_PROXY_LOOPBACK
	bool "Use CAN controller loopback mode"
	depends on CAN_ISOTP_PROXY
	default n
	help
	  Enables internal loopback mode of the CAN controller.
	  Useful for testing without physical CAN transceivers.

config CAN_ISOTP_PROXY_RECV_TIMEOUT_MS
	int "ISO-TP RX receive timeout"
	depends on CAN_ISOTP_PROXY
	default 2000
	help
	  Timeout in milliseconds for receiving messages over ISO-TP.
	  This is the maximum time to wait for a message to be received before
	  giving up.

config CAN_ISOTP_PROXY_ISOTP_TX_USE_SEND_TIMEOUT
	bool "Enable ISO-TP TX send timeout"
	depends on CAN_ISOTP_PROXY
	default y
	help
	  Enable the use of send timeout for ISO-TP TX operations.
	  This allows the system to wait for a specified time before retrying
	  to send a message if the previous attempt failed.

config CAN_ISOTP_PROXY_ISOTP_TX_TIMEOUT
	int "ISO-TP TX send timeout"
	depends on CAN_ISOTP_PROXY && CAN_ISOTP_PROXY_ISOTP_TX_USE_SEND_TIMEOUT
	default 100
	help
	  Timeout in milliseconds for sending messages over ISO-TP.
	  This is the maximum time to wait for a message to be sent before retrying.

config CAN_ISOTP_PROXY_RX_STACK_SIZE
	int "ISO-TP RX thread stack size"
	depends on CAN_ISOTP_PROXY
	default 1024
	help
	  Stack size in bytes for the ISO-TP receive thread.

config CAN_ISOTP_PROXY_RX_THREAD_PRIO
	int "ISO-TP RX thread priority"
	depends on CAN_ISOTP_PROXY
	default 4
	help
	  Thread priority for ISO-TP receive thread.

choice
	prompt "Log level for CAN ISOTP Proxy"
	default CAN_ISOTP_PROXY_LOG_LEVEL_INF
	depends on CAN_ISOTP_PROXY

config CAN_ISOTP_PROXY_LOG_LEVEL_OFF
	bool "Off"
config CAN_ISOTP_PROXY_LOG_LEVEL_ERR
	bool "Error"
config CAN_ISOTP_PROXY_LOG_LEVEL_WRN
	bool "Warning"
config CAN_ISOTP_PROXY_LOG_LEVEL_INF
	bool "Info"
config CAN_ISOTP_PROXY_LOG_LEVEL_DBG
	bool "Debug"

endchoice

config CAN_ISOTP_PROXY_LOG_LEVEL
	int "CAN ISOTP Proxy log level"
	depends on CAN_ISOTP_PROXY
	default 0 if CAN_ISOTP_PROXY_LOG_LEVEL_OFF
	default 1 if CAN_ISOTP_PROXY_LOG_LEVEL_ERR
	default 2 if CAN_ISOTP_PROXY_LOG_LEVEL_WRN
	default 3 if CAN_ISOTP_PROXY_LOG_LEVEL_INF
	default 4 if CAN_ISOTP_PROXY_LOG_LEVEL_DBG
	help
	  Log level for the CAN ISOTP Proxy.

endmenu
```

## samples/net/tcp_isotp_proxy/tcp_cmd_handler/Kconfig
```kconfig
menu "TCP Command Handler"

config TCP_CMD_HANDLER
    bool "Enable TCP command handler"
    depends on TCP_LINK
    default y
    help
      Enable command support for the TCP server, allowing
      remote control and configuration.

choice
    prompt "Log level for TCP Command Handler"
    default TCP_CMD_HANDLER_LOG_LEVEL_INF
    depends on TCP_CMD_HANDLER

config TCP_CMD_HANDLER_LOG_LEVEL_OFF
    bool "Off"
config TCP_CMD_HANDLER_LOG_LEVEL_ERR
    bool "Error"
config TCP_CMD_HANDLER_LOG_LEVEL_WRN
    bool "Warning"
config TCP_CMD_HANDLER_LOG_LEVEL_INF
    bool "Info"
config TCP_CMD_HANDLER_LOG_LEVEL_DBG
    bool "Debug"

endchoice

config TCP_CMD_HANDLER_LOG_LEVEL
    int "TCP Command Handler log level"
    depends on TCP_CMD_HANDLER
    default 0 if TCP_CMD_HANDLER_LOG_LEVEL_OFF
    default 1 if TCP_CMD_HANDLER_LOG_LEVEL_ERR
    default 2 if TCP_CMD_HANDLER_LOG_LEVEL_WRN
    default 3 if TCP_CMD_HANDLER_LOG_LEVEL_INF
    default 4 if TCP_CMD_HANDLER_LOG_LEVEL_DBG
    help
      Log level for the TCP Command Handler.

config TCP_CMD_HANDLER_DATA_MAX_LEN
    int "Maximum data length for TCP command handler"
    depends on TCP_CMD_HANDLER
    default 256
    help
      Maximum length of data that can be sent with a TCP command.
      This is the maximum size of the data buffer
      used for command processing.

config TCP_CMD_HANDLER_NAME_MAX_LEN
    int "Maximum name length for TCP command handler"
    depends on TCP_CMD_HANDLER
    default 32
    help
      Maximum length of the name that can be used for a TCP command.
      This is the maximum size of the name buffer used for command processing.

config TCP_CMD_HANDLER_NAME_MIN_LEN
    int "Minimum name length for TCP command handler"
    depends on TCP_CMD_HANDLER
    default 3
    help
      Minimum length of the name that can be used for a TCP command.
      This is the minimum size of the name buffer
      used for command processing.

config TCP_CMD_HANDLER_VAL_MAX_LEN
    int "Maximum value length for TCP command handler"
    depends on TCP_CMD_HANDLER
    default 11
    help
      Maximum length of the value that can be used for a TCP command.
      This is the maximum size of the value buffer
      used for command processing.
      It represents string values to be converted to integers.
      Default is 11 to accommodate signed 32-bit integers.

config TCP_CMD_HANDLER_VAL_MIN_LEN
    int "Minimum value length for TCP command handler"
    depends on TCP_CMD_HANDLER
    default 1
    help
      Minimum length of the value that can be used for a TCP command.
      This is the minimum size of the value buffer
      used for command processing.

config TCP_CMD_HANDLER_SPACES_MAX_LEN
    int "Maximum spaces amount for TCP command handler"
    depends on TCP_CMD_HANDLER
    default 16
    help
      Maximum number of spaces that can be used in a TCP command.
      This is the maximum size of the spaces buffer
      used for command processing.
      Note. After the data len before data should can be only the 1 space.
      All other signs are considered as part of the data.

config TCP_CMD_HANDLER_NAME_QUANT
    int "Maximum number of TCP commands name only type"
    depends on TCP_CMD_HANDLER
    default 32
    help
      Maximum number of commands name type that can be registered in the TCP 
      command handler.
      This is used to limit the number of commands that can be processed.

config TCP_CMD_HANDLER_VAL_QUANT
    int "Maximum number of TCP commands with value"
    depends on TCP_CMD_HANDLER
    default 32
    help
      Maximum number of commands with name-value that can be registered
      in the TCP command handler.

config TCP_CMD_HANDLER_DATA_QUANT
    int "Maximum number of TCP commands with data"
    depends on TCP_CMD_HANDLER
    default 16
    help
      Maximum number of commands with data that can be registered in the TCP
      command handler.

endmenu
```

## samples/net/tcp_isotp_proxy/tcp_link/Kconfig
```kconfig
menu "TCP Link Configuration"

config TCP_LINK
    bool "Enable TCP Link module"
    depends on NET_L2_ETHERNET && TX_MSG_QUEUE
    default n
    help
      Enable the TCP Link module that manages shared TCP connection,
      handles input parsing and transmits data from multiple sources.

config TCP_LINK_PORT
    int "TCP port for TCP Link server"
    depends on TCP_LINK
    default 4545
    help
      Port on which the TCP Link server listens for incoming connections.

config TCP_LINK_TX_MAX_PAYLOAD_SIZE
    int "TCP Link TX maximum payload size"
    depends on TCP_LINK
    default 512
    help
      Maximum size of the payload for TCP Link in bytes.
      This buffer is used to store outgoing messages before they are sent.

config TCP_LINK_RX_BUFFER_SIZE
    int "TCP Link RX buffer size"
    depends on TCP_LINK
    default 512
    help
      Size of the receive buffer for TCP Link in bytes.
      This buffer is used to store incoming messages before they are processed.

config TCP_LINK_RX_THREAD_NAME
    string "TCP Link RX thread name"
    depends on TCP_LINK
    default "tcp_link_rx_thread"
    help
      Name of the thread that handles receiving TCP data.

config TCP_LINK_RX_THREAD_STACK_SIZE
    int "TCP Link RX thread stack size"
    depends on TCP_LINK
    default 2048
    help
      Stack size (in bytes) for the thread receiving TCP data.

config TCP_LINK_RX_THREAD_PRIO
    int "TCP Link RX thread priority"
    depends on TCP_LINK
    default 3
    help
      Priority of the thread for TCP Link RX.

config TCP_LINK_MAX_CLIENTS
    int "Maximum simultaneous TCP clients"
    depends on TCP_LINK
    default 1
    help
      Maximum number of simultaneous TCP clients.
      Set to 1 if the server is intended for a single client only.

config TCP_LINK_TX_QUEUE_NAME
    string "TCP link TX queue name"
    default "tcp_link_tx_queue"
    depends on TCP_LINK
    help
      Queue name for internal TCP link transmission.

config TCP_LINK_TX_SRC_ID
    int "TCP Link TX source ID"
    depends on TCP_LINK && TX_MSG_QUEUE
    default 255
    help
      Name of the sender for TCP Link messages.

config TCP_LINK_TX_DST_ID
    int "TCP Link TX destination ID"
    depends on TCP_LINK && TX_MSG_QUEUE
    default 255
    help
      Name of the destination for TCP Link messages.

config TCP_LINK_TX_USE_SEND_TIMEOUT
    bool "Enable TCP Link TX send timeout"
    depends on TCP_LINK
    default y
    help
      Enable the use of send timeout for TCP Link TX operations.

config TCP_LINK_TX_SEND_TIMEOUT
    int "TCP Link TX send timeout"
    depends on TCP_LINK && TCP_LINK_TX_USE_SEND_TIMEOUT
    default 100
    help
      Timeout in milliseconds for sending messages over TCP Link.
      This is the maximum time to wait for a message to be sent.

choice
    prompt "Log level for TCP Link"
    default TCP_LINK_LOG_LEVEL_INF
    depends on TCP_LINK

config TCP_LINK_LOG_LEVEL_OFF
    bool "Off"
config TCP_LINK_LOG_LEVEL_ERR
    bool "Error"
config TCP_LINK_LOG_LEVEL_WRN
    bool "Warning"
config TCP_LINK_LOG_LEVEL_INF
    bool "Info"
config TCP_LINK_LOG_LEVEL_DBG
    bool "Debug"

endchoice

config TCP_LINK_LOG_LEVEL
    int "Log level for TCP Link"
    depends on TCP_LINK
    default  0 if TCP_LINK_LOG_LEVEL_OFF
    default  1 if TCP_LINK_LOG_LEVEL_ERR
    default  2 if TCP_LINK_LOG_LEVEL_WRN
    default  3 if TCP_LINK_LOG_LEVEL_INF
    default  4 if TCP_LINK_LOG_LEVEL_DBG
    help
      Logging level for the TCP Link module.

endmenu
```

## samples/net/tcp_isotp_proxy/tx_queue/Kconfig
```kconfig
# Copyright (c) 2025 N-Ix
# SPDX-License-Identifier: Apache-2.0

menu "TX Queue Configuration"

config TX_MSG_QUEUE
	bool "Enable message transmit queue"
	default n
	help
	  Enable a dedicated thread for handling message transmit queues.
	  This allows for better management of outgoing messages and can
	  improve performance.

choice
	prompt "Log level for TX message queue"
	default TX_MSG_QUEUE_LOG_LEVEL_INF
	depends on TX_MSG_QUEUE

config TX_MSG_QUEUE_LOG_LEVEL_OFF
	bool "Off"
config TX_MSG_QUEUE_LOG_LEVEL_ERR
	bool "Error"
config TX_MSG_QUEUE_LOG_LEVEL_WRN
	bool "Warning"
config TX_MSG_QUEUE_LOG_LEVEL_INF
	bool "Info"
config TX_MSG_QUEUE_LOG_LEVEL_DBG
	bool "Debug"

endchoice

config TX_MSG_QUEUE_LOG_LEVEL
	int "TX message queue log level"
	depends on TX_MSG_QUEUE
	default 0 if TX_MSG_QUEUE_LOG_LEVEL_OFF
	default 1 if TX_MSG_QUEUE_LOG_LEVEL_ERR
	default 2 if TX_MSG_QUEUE_LOG_LEVEL_WRN
	default 3 if TX_MSG_QUEUE_LOG_LEVEL_INF
	default 4 if TX_MSG_QUEUE_LOG_LEVEL_DBG
	help
	  Log level for the TX message queue.

config TX_MSG_QUEUE_THREAD_NAME
	string "TX message queue thread name"
	depends on TX_MSG_QUEUE
	default "tx_msg_queue_thread"
	help
	  Default name for the TX message queue.
	  This is used for identifying the queue in logs and debugging.

config TX_MSG_QUEUE_MAX_NAME_LEN
	int "TX message queue max name length"
	depends on TX_MSG_QUEUE
	default 32
	help
	  Maximum length of the name for the message transmit queue.
	  This is used for identifying the queue in logs and debugging.

config TX_MSG_QUEUE_MAX_QUANTITY
	int "TX message queue maximum quantity"
	depends on TX_MSG_QUEUE
	default 4
	help
	  Maximum number of queues.
	  This helps manage memory usage and ensures that the queue number is restricted.

config TX_MSG_QUEUE_PAYLOAD_MAX_SIZE
	int "TX message queue maximum payload size"
	depends on TX_MSG_QUEUE
	default 256
	help
	  Maximum size of the TX message queue payload in bytes.
	  This limits the amount of memory used for the queue and prevents excessive memory usage.
	  If the queue exceeds this size, packets may be dropped or delayed.

config TX_MSG_QUEUE_DEPTH
	int "TX message queue depth"
	depends on TX_MSG_QUEUE
	default 10
	help
	  Maximum number of packets that can be queued for transmission in the TX message queue.
	  This helps manage memory usage and ensures that the queue does not grow indefinitely.

config TX_MSG_QUEUE_THREAD_STACK_SIZE
	int "TX message queue thread stack size"
	depends on TX_MSG_QUEUE
	default 1024
	help
	  Stack size in bytes for the TX message queue thread.

config TX_MSG_QUEUE_THREAD_PRIO
	int "TX message queue thread priority"
	depends on TX_MSG_QUEUE
	default 3
	help
	  Thread priority for the TCP transmit queue thread.

endmenu
```
