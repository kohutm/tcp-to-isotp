## CMakeLists.txt
```
# SPDX-License-Identifier: Apache-2.0

cmake_minimum_required(VERSION 3.20.0)

find_package(Zephyr REQUIRED HINTS $ENV{ZEPHYR_BASE})

project(tcp_to_isotp_proxy)

target_sources(app PRIVATE src/main.c)

add_subdirectory_ifdef(CONFIG_TCP_CMD_HANDLER tcp_cmd_handler)

add_subdirectory_ifdef(CONFIG_TX_MSG_QUEUE tx_queue)

add_subdirectory_ifdef(CONFIG_TCP_LINK tcp_link)

add_subdirectory_ifdef(CONFIG_CAN_ISOTP_PROXY iso_tp_proxy)
```

## Kconfig
```
# Copyright (c) 2025 N-Ix
# SPDX-License-Identifier: Apache-2.0

mainmenu "TCP ISO-TP Proxy App"

source "Kconfig.zephyr"

rsource "tx_queue/Kconfig"
rsource "tcp_link/Kconfig"
rsource "iso_tp_proxy/Kconfig"
rsource "tcp_cmd_handler/Kconfig"
```

## prj.conf
```kconfig
# nothing here
CONFIG_NETWORKING=y
CONFIG_ETH_STM32_HAL=y
CONFIG_NET_L2_ETHERNET=y
CONFIG_NET_CONFIG_SETTINGS=y
CONFIG_NET_IPV4=y
CONFIG_NET_TCP=y
CONFIG_NET_SOCKETS=y
CONFIG_NET_SOCKETS_SERVICE=y
CONFIG_POSIX_API=y

CONFIG_NET_DHCPV4=y
CONFIG_NET_MGMT=y
CONFIG_NET_MGMT_EVENT=y
CONFIG_NET_LOG=y

CONFIG_MAIN_STACK_SIZE=2048
CONFIG_HEAP_MEM_POOL_SIZE=16384

CONFIG_LOG=y
CONFIG_GPIO=y

CONFIG_TCP_CMD_HANDLER=y
CONFIG_TCP_CMD_HANDLER_LOG_LEVEL_DBG=y

# Enable CAN bus support and ISOTP protocol
CONFIG_CAN=y
CONFIG_CAN_MAX_FILTER=8

CONFIG_ISOTP=y
CONFIG_CAN_ISOTP_PROXY=y
CONFIG_CAN_ISOTP_PROXY_LOG_LEVEL_DBG=y
# We have two receiving contexts that are bound to a single address.
# CONFIG_ISOTP_RX_SF_FF_BUF_COUNT=2
CONFIG_CAN_ISOTP_PROXY_LOOPBACK=y

CONFIG_TX_MSG_QUEUE=y
CONFIG_TX_MSG_QUEUE_LOG_LEVEL_DBG=y

CONFIG_TCP_LINK=y
CONFIG_TCP_LINK_LOG_LEVEL_DBG=y
```

## boards/nucleo_f439zi.overlay
```dts
/ {
	chosen {
		zephyr,canbus = &can1;
	};
};

&can1 {
	status = "okay";
	sample-point = <875>;
	pinctrl-0 = <&can1_rx_pd0 &can1_tx_pd1>;
	pinctrl-names = "default";
};
```

## src/main.c
```c
/*
 * Copyright (c) 2025 N-Ix
 *
 * SPDX-License-Identifier: Apache-2.0
 */

#include <stdio.h>
#include <zephyr/kernel.h>
#include <zephyr/drivers/gpio.h>

#include <zephyr/net/net_if.h>
#include <zephyr/net/net_ip.h>

#include <zephyr/net/net_mgmt.h>
#include <zephyr/net/socket.h>
#include <zephyr/logging/log.h>

#if defined(CONFIG_TCP_CMD_HANDLER)
#include "tcp_cmd_handler.h"
#endif
#if defined(CONFIG_TCP_LINK)
#include "tcp_link.h"
#endif
#if defined(CONFIG_TX_MSG_QUEUE)
#include "tx_queue.h"
#endif
#if defined(CONFIG_CAN_ISOTP_PROXY)
#include "isotp_proxy.h"
#endif

LOG_MODULE_REGISTER(main, LOG_LEVEL_DBG);

/* Staff for Alive status LED */
#define HEART_BEAT_INTERVAL   1000
static const struct gpio_dt_spec led = GPIO_DT_SPEC_GET(DT_ALIAS(led0), gpios);

static int init_led(void)
{
	if (!gpio_is_ready_dt(&led)) {
		return -ENODEV;
	}

	return gpio_pin_configure_dt(&led, GPIO_OUTPUT_ACTIVE);
}

int main(void)
{
	LOG_INF("Ethernet - ISO-TP Proxy Application!");
	LOG_INF("Board STM32: %s", CONFIG_BOARD_TARGET);

	if (init_led() < 0) {
		LOG_ERR("Failed to initialize LED\n");
		return -1;
	}

#if defined(CONFIG_TX_MSG_QUEUE)
	tx_msg_queue_system_init();
#endif

#if defined(CONFIG_TCP_LINK)
	tcp_link_init();
#endif

#if defined(CONFIG_CAN_ISOTP_PROXY)
	isotp_proxy_init();
#endif

	while (1) {
		gpio_pin_toggle_dt(&led);
		k_msleep(HEART_BEAT_INTERVAL);
	}

	return 0;
}
```
